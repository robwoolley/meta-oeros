## conf/distro/include/zenoh.inc
```bitbake
# Copyright (c) 2026 Wind River Systems, Inc.

# Set distro-level settings for meta-zenoh
ZENOH_SHARED_MEMORY = "true"
ZENOH_UNSTABLE_API = "true"
```

## conf/distro/oeros.conf
```bitbake
# Copyright (c) 2026 Wind River Systems, Inc.

# OpenEmbedded ROS (OE ROS) Reference Distribution
DISTRO = "oeros"
DISTRO_NAME = "Oeros (OpenEmbedded ROS Reference Distro)"
DISTRO_VERSION = "2026.04"
DISTRO_CODENAME = "alpha"

MAINTAINER = "Rob Woolley <rob.woolley@windriver.com>"

TARGET_VENDOR = "-oeros"

LOCALCONF_VERSION = "2"

DISTRO_FEATURES ?= "${OEROS_DEFAULT_DISTRO_FEATURES}"

DISTRO_FEATURES:append = " virtualization"
DISTRO_FEATURES:append = " wayland opengl vulkan polkit"
DISTRO_FEATURES:append = " opencl"
DISTRO_FEATURES:append = " pam"

DISTRO_EXTRA_RDEPENDS += "${OEROS_DEFAULT_EXTRA_RDEPENDS}"
DISTRO_EXTRA_RRECOMMENDS += "${OEROS_DEFAULT_EXTRA_RRECOMMENDS}"

BB_SIGNATURE_HANDLER ?= "OEEquivHash"
BB_HASHSERVE ??= "auto"

require conf/distro/include/packageconfig.inc
require conf/distro/include/zenoh.inc
```
